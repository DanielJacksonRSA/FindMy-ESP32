// ESP32 Find My tag
//
// Broadcasts Apple's Find My BLE advertisements from a rotating set of
// public keys, so nearby iPhones report the tag's location back through
// Apple's network. Only the owner of the private keys can look the tag up.
//
// Keys come from public_keys.h, generated by generate_keys.py:
//
//   python3 generate_keys.py --nkeys 20 --emit-firmware -o firmware
//
// Never commit public_keys.h for a real deployment. The public keys alone
// let anyone correlate your tag, and the matching private keys (in output/)
// are a secret.

#include <Arduino.h>
#include <BLEDevice.h>
#include <BLEUtils.h>
#include <BLEServer.h>
#include <esp_mac.h>
#include <esp_system.h>
#include <esp_sleep.h>

#include "public_keys.h"  // provides NUM_KEYS and publicKeys[NUM_KEYS][28]

// Timing. Deep sleep between bursts is what gets the battery life.
static const uint32_t AWAKE_MS        = 500;     // long enough for iPhones to catch the packet
static const uint32_t SLEEP_US        = 4500000; // 4.5 s asleep per cycle
static const uint32_t CYCLE_MS        = 5000;    // 0.5 s awake + 4.5 s asleep
static const uint32_t KEY_ROTATE_MS   = 900000;  // 15 minutes per key
static const int      STATUS_LED      = 8;

// These survive the deep-sleep reboots.
RTC_DATA_ATTR int currentKeyIndex = 0;
RTC_DATA_ATTR unsigned long elapsedTimeMs = 0;

BLEAdvertising *pAdvertising;

// The broadcast MAC is derived from the first 6 bytes of the public key.
// esp_base_mac_addr_set wants the base address, which is 2 below the
// broadcast (static) address, so subtract 2 with borrow.
static void setBaseMAC(const uint8_t* target_bt_mac) {
  uint8_t base_mac[6];
  memcpy(base_mac, target_bt_mac, 6);

  uint8_t borrow = 2;
  for (int i = 5; i >= 0; i--) {
    if (base_mac[i] >= borrow) {
      base_mac[i] -= borrow;
      borrow = 0;
      break;
    }
    base_mac[i] = (256 + base_mac[i]) - borrow;
    borrow = 1;
  }
  esp_base_mac_addr_set(base_mac);
}

void setup() {
  pinMode(STATUS_LED, OUTPUT);
  digitalWrite(STATUS_LED, HIGH); // LED off
  Serial.begin(115200);
  delay(100);

  // Rotate to the next key every 15 minutes of accumulated awake+sleep time.
  if (elapsedTimeMs >= KEY_ROTATE_MS) {
    currentKeyIndex = (currentKeyIndex + 1) % NUM_KEYS;
    elapsedTimeMs = 0;
    Serial.println("15 minutes passed. Rotating key.");
  }

  // MAC from the first 6 bytes of the current public key.
  uint8_t target_mac[6];
  for (int i = 0; i < 6; i++) {
    target_mac[i] = publicKeys[currentKeyIndex][i];
  }
  target_mac[0] |= 0b11000000; // static random address
  setBaseMAC(target_mac);

  // BLE init, max transmit power (+9 dBm).
  BLEDevice::init("");
  BLEDevice::setPower(ESP_PWR_LVL_P9, ESP_BLE_PWR_TYPE_DEFAULT);
  BLEDevice::setPower(ESP_PWR_LVL_P9, ESP_BLE_PWR_TYPE_ADV);
  pAdvertising = BLEDevice::getAdvertising();

  // Apple Find My payload:
  //   company ID 0x004C, type 0x12 (offline finding), length 0x19, status 0x00
  uint8_t m_data[29];
  m_data[0] = 0x4C;
  m_data[1] = 0x00;
  m_data[2] = 0x12;
  m_data[3] = 0x19;
  m_data[4] = 0x00;

  for (int i = 0; i < 22; i++) {
    m_data[5 + i] = publicKeys[currentKeyIndex][i + 6];
  }

  m_data[27] = publicKeys[currentKeyIndex][0] >> 6;
  m_data[28] = 0x00;

  String payloadStr = String((char*)m_data, 29);
  BLEAdvertisementData oAdvertisementData = BLEAdvertisementData();
  oAdvertisementData.setManufacturerData(payloadStr);
  pAdvertising->setAdvertisementData(oAdvertisementData);

  BLEAdvertisementData oScanResponseData = BLEAdvertisementData();
  pAdvertising->setScanResponseData(oScanResponseData);

  pAdvertising->start();
  digitalWrite(STATUS_LED, LOW); // LED on while broadcasting

  delay(AWAKE_MS);

  elapsedTimeMs += CYCLE_MS;

  digitalWrite(STATUS_LED, HIGH); // LED off before sleep
  esp_sleep_enable_timer_wakeup(SLEEP_US);
  esp_deep_sleep_start();
}

void loop() {
  // Empty: deep sleep resets the board every cycle.
}
